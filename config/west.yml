## config/west.yml
```yaml
manifest:
  remotes:
    - name: zmkfirmware
      url-base: https://github.com/zmkfirmware
    - name: urob
      url-base: https://github.com/urob
    # Additional modules containing boards/shields/custom code can be listed here as well
    # See https://docs.zephyrproject.org/3.2.0/develop/west/manifest.html#projects
  projects:
    - name: zmk
      # remote: zmkfirmware
      remote: urob
      revision: main
      import: app/west.yml
      # Remote additions
    - name: zmk-helpers
      remote: urob
      revision: v2
  self:
    path: config
```
